#include "audio.dtsi"
#include "pinctrl.dtsi"
#include "pinctrl-cam.dtsi"
#include "cam-sensor.dtsi"
#include "cam-qrd.dtsi"
#include "regulator.dtsi"
#include "mdss.dtsi"
#include "i2c.dtsi"
#include "rolex-pm.dtsi"
#include "rolex-general.dtsi"
#include "sku5.dtsi"
#include "spmi.dtsi"