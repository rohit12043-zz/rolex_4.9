#include "rolex-audio.dtsi"
#include "rolex-camera-qrd.dtsi"
#include "rolex-camera_pinctrl.dtsi"
#include "rolex-general.dtsi"
#include "rolex-mdss.dtsi"
#include "rolex-pinctrl.dtsi"
#include "rolex-regulator.dtsi"
#include "rolex-sku5.dtsi"